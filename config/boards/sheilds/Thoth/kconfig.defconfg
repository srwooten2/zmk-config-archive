## config/boards/sheilds/Thoth/kconfig.defconfg
```kconfig
# Copyright (c) 2020 The ZMK Contributors
# SPDX-License-Identifier: MIT

if SHIELD_Thoth

config ZMK_KEYBOARD_NAME
	default "Thoth"

endif
```

## config/boards/sheilds/Thoth/kconfig.shield
```kconfig
# Copyright (c) 2020 The ZMK Contributors
# SPDX-License-Identifier: MIT

config SHIELD_Thoth
	def_bool $(shields_list_contains,Thoth
```

## config/west.yml
```yaml
manifest:
  remotes:
    - name: srwooten2
      url-base: https://github.com/srwooten2
  projects:
    - name: zmk
      remote: zmkfirmware
      revision: main
      import: app/west.yml
  self:
    path: config
```
